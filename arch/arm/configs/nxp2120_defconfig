## arch/arm/configs/nxp2120_defconfig
```kconfig
CONFIG_EXPERIMENTAL=y
CONFIG_SYSFS_DEPRECATED_V2=y
CONFIG_BLK_DEV_INITRD=y
CONFIG_KALLSYMS_ALL=y
CONFIG_MODULES=y
CONFIG_MODULE_UNLOAD=y
CONFIG_ARCH_MULTIPLATFORM=n
CONFIG_NEED_MACH_MEMORY_H=y
CONFIG_ARCH_NXP2120=y
CONFIG_MACH_WEBCON=y
CONFIG_CPU_32v6K=y
CONFIG_AEABI=y
CONFIG_CMDLINE="console=ttyS0,115200n8 root=/dev/ram0 rw initrd=0x82000000,24M ramdisk=24576"
CONFIG_VFP=y
CONFIG_PM=y
CONFIG_UEVENT_HELPER_PATH="/sbin/hotplug"
CONFIG_BLK_DEV_LOOP=y
CONFIG_BLK_DEV_RAM=y
CONFIG_HW_RANDOM=y
CONFIG_EXT2_FS=y
CONFIG_EXT3_FS=y
CONFIG_EXT3_FS_POSIX_ACL=y
CONFIG_EXT3_FS_SECURITY=y
CONFIG_INOTIFY=y
CONFIG_TMPFS=y
CONFIG_TMPFS_POSIX_ACL=y
CONFIG_MAGIC_SYSRQ=y
CONFIG_DEBUG_KERNEL=y
CONFIG_DEBUG_RT_MUTEXES=y
CONFIG_DEBUG_SPINLOCK=y
CONFIG_DEBUG_MUTEXES=y
CONFIG_DEBUG_SPINLOCK_SLEEP=y
CONFIG_DEBUG_INFO=y
CONFIG_SYSCTL_SYSCALL_CHECK=y
CONFIG_DEBUG_USER=y
CONFIG_DEBUG_ERRORS=y
CONFIG_DEBUG_LL=y
```

## arch/arm/mach-nxp2120/Kconfig
```kconfig
config ARCH_NEXELL
	bool
	default y

config PLAT_NXP2120
	bool
	default y

choice
	prompt "Prototype build mode"
	default PROTOTYPE_NXP2120_DBG

	config  PROTOTYPE_NXP2120_REL
		bool "Release"

	config  PROTOTYPE_NXP2120_DBG
		bool "Debug"
endchoice

# NXP2120 Macchine support

config NXP2120_USB_BUGFIX
	bool "Use nxp2120 usb host bugfix code"
	depends on USB_SUPPORT
	default y
	help
		check if use nxp2120 usb host bugfix code in usb ehci host driver

config MACH_WEBCON
       bool "WEBCON"
	   depends on ARCH_NXP2120
	help
	  Machine support for the FALINUX WEBCON

source "arch/arm/mach-nxp2120/Kconfig.webconn-chip"

comment "NXP2120 Add features"

config HAVE_PWM
	prompt "Support pwm device"
	bool
	default y

config ARCH_REQUIRE_GPIOLIB
	prompt "Support generic gpio library"
	bool
	default y
```

## arch/arm/mach-nxp2120/Kconfig.webconn-chip
```kconfig
choice
	prompt "Webconn Module Chip Type"
	depends on MACH_WEBCON
	default WEBCONN_DEFAULT

config WEBCONN_DEFAULT
	bool "Webconn Default"
	help
		Description

config WEBCONN_T_USB
	bool "Webconn 01. T-USB"
	help 

config WEBCONN_T_SPI
	bool "Webconn 02. T-SPI"
	help 
		Description

config WEBCONN_T_I2C
	bool "Webconn 03. T-I2C"
	help 
		Description

config WEBCONN_T_UART_TTL
	bool "Webconn 04. T-UART-TTL"
	help 
		Description

config WEBCONN_T_AI_2CH
	bool "Webconn 05. T-AI-2CH"
	help 
		Description

config WEBCONN_T_PWM
	bool "Webconn 06. T-PWM"
	help 
		Description

config WEBCONN_T_POWER
	bool "Webconn 07. T-POWER"
	help 
		Description

config WEBCONN_T_GPIO_4CH
	bool "Webconn 08. T-GPIO-4CH"
	help 
		Description

config WEBCONN_T_ETHERNET
	bool "Webconn 09. T-ETHERNET"
	help 
		Description

config WEBCONN_T_RS232
	bool "Webconn 10. T-RS232"
	help 
		Description

config WEBCONN_T_JIG
	bool "Webconn 11. T-JIG"
	help 
		Description

config WEBCONN_T_SENSOR_CURRENT
	bool "Webconn 12. T-SENSOR-CURRENT"
	help 
		Description

config WEBCONN_T_DIGITAL_INPUT_1CH
	bool "Webconn 13. T-DIGITAL-INPUT-1CH"
	help 
		Description

config WEBCONN_T_DIGITAL_INPUT_8CH
	bool "Webconn 14. T-DIGITAL-INPUT-8CH"
	help 
		Description

config WEBCONN_T_DIGITAL_OUTPUT_1CH
	bool "Webconn 15. T-DIGITAL-OUT-1CH"
	help 
		Description

config WEBCONN_T_DIGITAL_OUTPUT_8CH
	bool "Webconn 16. T-DIGITAL-OUT-8CH"
	help 
		Description

config WEBCONN_T_RELAY_1
	bool "Webconn 17. T-RELAY-1"
	help 
		Description

config WEBCONN_T_USB_HUB
	bool "Webconn 18. T-USB-HUB"
	help 
		Description

config WEBCONN_T_RS485
	bool "Webconn 19. T-RS485"
	help 
		Description

config WEBCONN_T_RS422
	bool "Webconn 20. T-RS422"
	help 
		Description

endchoice
```

## drivers/misc/nexell/Kconfig
```kconfig
#
# Copyright 2010 Nexell.
#
# Configuration options for the Nexell misc drivers

config MISC_NEXELL_ADC
	bool "Nexell ADC (Analog to Digital Converter) driver"
	depends on MISC_NEXELL

config MISC_NEXELL_PWM
	bool "Nexell PWM (Pulse Width Modulation) driver"
	depends on MISC_NEXELL

config MISC_NEXELL_PMI
	bool "Nexell PMI (Power Manager Interface) driver"
	depends on MISC_NEXELL && PM

config MISC_NEXELL_SPI
	bool "Nexell SPI (Serial Peripheral Interface) driver"
	depends on MISC_NEXELL

config MISC_NEXELL_GPIO
	bool "Nexell GPIO (General Purpose IO) driver"
	depends on MISC_NEXELL

config MISC_NEXELL_DIBDXB
	bool "Nexell DiBcom DXB(I2C) driver"
	depends on MISC_NEXELL
	
config MISC_NEXELL_TIMER_90K
	bool "Nexell 90 Khz timer driver"
	depends on MISC_NEXELL && PLAT_NXP2120_PR

config MISC_NEXELL_MPEGTS
	bool "Nexell mpegtsif driver"
	depends on MISC_NEXELL

config MISC_NEXELL_GPIOMON
	bool "Nexell gpio monitor driver"
	depends on MISC_NEXELL

config MISC_NEXELL_VSTATION
	bool "Nexell vstation driver"
	depends on MISC_NEXELL

config MISC_NEXELL_BUZZER
	bool "Nexell Buzzer driver"
	depends on MISC_NEXELL
```
